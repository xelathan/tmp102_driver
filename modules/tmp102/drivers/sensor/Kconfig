## modules/tmp102/drivers/sensor/ti/tmp102/Kconfig
```kconfig
config TMP102
    bool "TMP102 Temperature Sensor"
    default y
    depends on DT_HAS_TI_TMP102_ENABLED
    select I2C
    help 
        Custom TMP102 driver without reliance on TMP112 driver.
```

## modules/tmp102/dts/bindings/sensor/ti,tmp102.yaml
```yaml
# Copyright (c) 2025, Alex Tran
# SPDX-License-Identifier: Apache-2.0

description: |
    TMP102 Digital Temperature Sensor.  See more info at
    https://www.ti.com/product/TMP102

compatible: "ti,tmp102"

include: [sensor-device.yaml, i2c-device.yaml]

properties:
  conversion-rate:
    description: Conversion rate in mHz (milli-Hertz)
    type: int
    default: 4000
    enum:
      - 250
      - 1000
      - 4000
      - 8000

  extended-mode:
    description: When true use 13-bit data format allowing measuring temperature up to 150°C
    type: boolean

  t-low-micro-c:
    description: |
      Sets the default tLow threshold in micro-Celsius. The default value is the chip reset
      value.
    type: int
    default: 75000000

  t-high-micro-c:
    description: |
      Sets the default tHigh threshold in micro-Celsius. The default value is the chip reset
      value.
    type: int
    default: 85000000
```
